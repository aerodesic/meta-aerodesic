## conf/layer.conf
```bitbake
# We have a conf and classes directory, add to BBPATH
BBPATH .= ":${LAYERDIR}"

# We have a recipes-* directories, add to BBFILES
BBFILES += "${LAYERDIR}/recipes-*/*/*.bb \
    ${LAYERDIR}/recipes-*/*/*.bbappend"

BBFILE_COLLECTIONS += "meta-aerodesic"
BBFILE_PATTERN_meta-aerodesic = "^${LAYERDIR}/"
BBFILE_PRIORITY_meta-aerodesic = "6"

LAYERSERIES_COMPAT_meta-aerodesic = "sumo thud warrior zeus dunfell gatesgarth"
```
